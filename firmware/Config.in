## firmware/Config.in
```kconfig
menu "MeuPocketGB"
	source "$BR2_EXTERNAL_MEUPOCKETGB_PATH/package/gambatte-meupocketgb/Config.in"
endmenu
```

## firmware/package/gambatte-meupocketgb/Config.in
```kconfig
config BR2_PACKAGE_GAMBATTE_MEUPOCKETGB
	bool "gambatte-meupocketgb"
	depends on BR2_INSTALL_LIBSTDCPP
	select BR2_PACKAGE_SDL
	select BR2_PACKAGE_SDL_IMAGE
	select BR2_PACKAGE_SDL_IMAGE_PNG
	select BR2_PACKAGE_SDL_MIXER
	select BR2_PACKAGE_ZLIB
	help
	  Gambatte-DMS (Game Boy / Game Boy Color) com os patches do
	  MeuPocketGB: abre direto na lista de jogos e grava o save do
	  jogo no cartao assim que ele muda.

	  https://github.com/tiopex/gambatte-dms

comment "gambatte-meupocketgb needs a toolchain w/ C++"
	depends on !BR2_INSTALL_LIBSTDCPP
```
